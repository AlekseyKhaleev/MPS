; Тустирование работы внешнего прерывания
.include "1200def.inc"	; Описалово на микроконтроллер at90s1200

.cseg
.org 0
	rjmp	reset
	rjmp	ext_int		; Вектор внешнего прерывания

; Обработчик прерывания "RESET"
; Как правило, здесь выполняется инициализация программы, подготовка к работе, так сказать
reset:	
	ldi		r16,0xff	; Настройка портов
	out		DDRB,r16
	ldi		r16,0x01
	out		DDRD,r16

	ldi		r16,0x00
	out		PORTB,r16
	
	ldi		r16,0x00
	out		PORTD,r16
	
    ldi		r16,0x00	; Настройка внешнего прерывания: прерывание наступает при понижающемся уровне сигнала
	out		MCUCR,r16
	ldi		r16,0x40	; Разрешение внешнего прерывания
    out		GIMSK,r16

    clr		r16
    
    sei					; Разрешение прерываний

; Главный цикл
; Здесь происходит только ожидание возникновения внешнего прерывания
main:
	nop
	rjmp	main

; Обработчик внешнего прерывания
; Простой вывод в порт B инкрементированного значения регистра r16
ext_int:
	inc		r16
	out		PORTB,r16
    reti
 
