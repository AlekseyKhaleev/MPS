; Тестирование портов: ввод-вывод
; Проект состоит из 2-х частей: передатчика и приёмника
; Данный код для приёмника.
; Приёмник принимает данные и отображает на 8-светодиодной линейке
; Данные передаются по 4-битной шине, используется сигнал готовности данных
.include "1200def.inc"

.cseg
.org 0

; Обработчик прерывания "RESET"
; Как правило, здесь выполняется инициализация программы, подготовка к работе, так сказать
reset:
	ldi		r16,0xff
	out		DDRB,r16	; Порт для индикаторов
	ldi		r17,0x00
	out		PORTB,r17
	out		DDRD,r17	; Порт для 4-битной шины данных и бита готовности
	ldi		r19,0x00	; Счётчик тетрад

; Главный цикл
main:
	sbis	PIND,PD4	; Проверка готовности данных (отслеживание высокого уровня бита готовности)
	rjmp	main
	inc		r19
	in		r16,PIND	; Чтение тетрады
	andi	r16,0x0f
	sbrc	r19,1
	swap	r16
	or		r17,r16
	sbrs	r19,1
	rjmp	child
	out		PORTB,r17	; Вывод данных на индикаторы
	clr		r19			; Очистка счётчика команд
	clr		r17

; Child loop
child:
	sbic	PIND,PD4	; Ожидание сброса бита готовности данных
	rjmp	child
	rjmp	main
