; Тестирование портов: ввод-вывод
; Проект состоит из 2-х частей: передатчика и приёмника
; Данный код для передатчика.
; Передатчик опрашивает 8-кнопочную клавиатуру, полученные данные передаются приёмнику
; Данные передаются по 4-битной шине, используется сигнал готовности данных
.include "1200def.inc"

.cseg
.org 0

; Обработчик прерывания "RESET"
; Как правило, здесь выполняется инициализация программы, подготовка к работе, так сказать
reset:
	ldi		r16,0x00
	out		DDRB,r16	; Порт для клавиатуры
	out		PORTB,r16
	ldi		r17,0x1f
	out		DDRD,r17	; Порт для 4-битной шины данных и бита готовности
	ldi		r19,0x00	; Счётчик тетрад

; Главный цикл
; Опрос клавиатуры, при изменении её состояния данные передаются приёмнику
main:
	in		r17,PINB	; Чтение состояния клавиатуры
	cp		r17,r16		; Проверка изменений
	breq	main		; Изменений нет - снова проверяем, иначе обрабатываем изменения
	mov		r16,r17		; Сохранение изменений для следующей проверки
	rcall	tranceive	; Вызов процедуры передачи данных
	rjmp	main

; Передача данных по 4-битной шине с использованием бита готовности данных
; Передаётся 1 байт в две передачи, по тетраде за передачу
tranceive:
	inc		r19			; Инкремент счётчика тетрад
	andi	r17,0x0f	; Подготовка первой тетрады
	ori		r17,0x10	; Установка бита готовности данных
	out		PORTD,r17
	rcall	delay		; Задержка, ожидание пока приёмник прочитает данные
	cpi		r19,0x02	; Проверка завершения передачи
	breq	tr_end
	mov		r17,r16
	swap	r17			; Подготовка второй тетрады
	rjmp	tranceive
tr_end:
	ldi		r19,0x00	; Сброс счётчика тетрад
	ret

; Маленькая задержка
; Ожидание пока приёмник прочитает данные
delay:
	ldi		r18,0x01	; Длительность задержки
wait:
	dec		r18
	cpi		r18,0x00	; Проверка не истекло ли время задержки
	brne	wait
	out		PORTD,r18	; Сброс бита готовности данных
	ret
