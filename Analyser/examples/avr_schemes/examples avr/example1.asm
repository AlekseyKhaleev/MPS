; Пример 1
; Управление светодиодными индикаторами

; Заголовочный файл для микроконтроллера AT90S1200
.include "1200def.inc"

; Сегмент кода
.cseg

; Начало кода с 0-го адреса памяти программ
.org 0

; Инициализация
reset:	
	ldi		r16,0xff	; Настройка выводов портов B и D в качестве выходов
	out		DDRB,r16	; Порт для индикаторов
	out		DDRD,r16	; Порт для индикаторов
	ldi		r18,0x80	; Флаг направления
	ldi		r16,0x01
	out		PORTB,r16	; Начальное значение порта B
	ldi		r17,0x80
	out		PORTD,r17	; Начальное значение порта D

; Главный рабочий цикл
main:
	nop
	cpi		r18,0x80	; Проверка направления
	brne		case_2
	lsl		r16		; Сдвиг светодиодного огонька в направлении 1
	lsr		r17		; Сдвиг светодиодного огонька в направлении 1
	rjmp		check
case_2:
	lsl		r17		; Сдвиг светодиодного огонька в направлении 2
	lsr		r16		; Сдвиг светодиодного огонька в направлении 2
check:
	cpse		r16,r18	; Проверка завершения цикла отображения по направлению
	rjmp		ports
	cpi		r18,0x80	; Проверка направления
	breq		do_case_2
	ldi		r18,0x80	; Установка направления 1
	rjmp		ports
do_case_2:
	ldi		r18,0x01	; Установка направления 2
ports:
	out		PORTB,r16	; Вывод в порт B, отображение сдвинутого светодиодного огонька
	out		PORTD,r17	; Вывод в порт B, отображение сдвинутого светодиодного огонька
	rjmp		main		; Возврат к началу главного рабочего цикла
 
